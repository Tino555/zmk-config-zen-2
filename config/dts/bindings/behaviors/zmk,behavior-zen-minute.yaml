## config/dts/bindings/behaviors/zmk,behavior-zen-minute.yaml
```yaml
# SPDX-License-Identifier: MIT
description: Receive completed key count window from the central half
compatible: "zmk,behavior-zen-minute"
include: two_param.yaml
```
